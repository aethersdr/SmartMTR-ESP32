## main/Kconfig.projbuild
```kconfig
menu "AetherKnob"

    config AETHERKNOB_BRINGUP
        bool "Bring-up mode: no USB link, console on the USB port"
        default n
        help
            For bringing up the board. The USB port stays the chip's
            USB-Serial/JTAG console (also set CONFIG_ESP_CONSOLE_USB_SERIAL_JTAG)
            instead of the HID link to AetherSDR, and dial turns and touches
            are logged. The port then also flashes without the BOOT button.

endmenu
```
